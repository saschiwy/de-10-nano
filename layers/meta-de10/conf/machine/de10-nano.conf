## layers/meta-de10/conf/machine/de10-nano.conf
```bitbake
#@TYPE: Machine
#@NAME: de10-nano
#@DESCRIPTION: Machine configuration for the Cyclone V DE10-Nano"

require conf/machine/cyclone5.conf

PREFERRED_PROVIDER_virtual/kernel = "linux-socfpga-lts"
PREFERRED_VERSION_u-boot-socfpga = "v2025.10%"

UBOOT_CONFIG = "de10-nano-soc"

# DTB for Linux kernel boot via extlinux.conf.
UBOOT_EXTLINUX_FDT:default = "../socfpga_cyclone5_de10nano.dtb"
UBOOT_EXTLINUX_ROOT:default = "root=/dev/mmcblk0p2"
UBOOT_EXTLINUX_MENU_DESCRIPTION:default = "DE10-Nano SDMMC"

# #SOCFPGA_SDIMG_EXTRA_FILES = "de10-nano.rbf de0-nano.rbf LICENSE.de10-nano.rbf LICENSE.de0-nano.rbf de10_nano_hdmi_config.bin dump_adv7513_edid.bin dump_adv7513_regs.bin STARTUP.BMP STARTUP.BMP.LICENSE"

# INHERIT += " rootfs_ipk "
# # This is to remove unmaintained packages which pose security/support issues
# BAD_RECOMMENDATIONS = " libavahi-core avahi-utils avahi-daemon avahi-autoipd libnss-mdns cpufrequtils fbset consolekit wireless-tools "
# #RDEPENDS_pulseaudio-module-console-kit_remove = "consolekit"

# DISTRO_FEATURES:remove = "opengl"                                               
# DISTRO_FEATURES:remove = "opencl"                                               
# DISTRO_FEATURES:remove = "wayland"                                              
# DISTRO_FEATURES:remove = "zeroconf"

# # remove wireless-tools as it is unmaintained
# VIRTUAL-RUNTIME_wireless-tools = "iw"

KERNEL_DEVICETREE += "intel/socfpga/socfpga_cyclone5_de10nano.dtb"
SPL_BINARY = "u-boot-with-spl.sfp"

IMAGE_BOOT_FILES += " \
	socfpga_cyclone5_de10nano.dtb \
	"
```
